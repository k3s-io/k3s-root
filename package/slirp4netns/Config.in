## package/slirp4netns/Config.in
```kconfig
config BR2_PACKAGE_SLIRP4NETNS
	bool "slirp4netns"
	depends on BR2_USE_MMU # fork()
	depends on BR2_TOOLCHAIN_HAS_THREADS
	select BR2_PACKAGE_LIBCAP
	select BR2_PACKAGE_LIBSECCOMP
	select BR2_PACKAGE_SLIRP
	help
	  https://github.com/rootless-containers/slirp4netns

comment "slirp4netns needs a toolchain w/ threads"
	depends on BR2_USE_MMU
	depends on BR2_TOOLCHAIN_HAS_THREADS
```
